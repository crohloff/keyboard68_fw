## boards/arm/nrf52840_module/Kconfig
```kconfig
# nRF52840 module board configuration

# Copyright (c) 2016 Nordic Semiconductor ASA
# SPDX-License-Identifier: Apache-2.0

if BOARD_NRF52840_MODULE

config BOARD_ENABLE_DCDC
	bool "Enable DCDC mode"
	select SOC_DCDC_NRF52X
	default y

endif # BOARD_NRF52840_MODULE
```

## boards/arm/nrf52840_module/Kconfig.board
```kconfig
# nRF52840 Module board configuration

# Copyright (c) 2016 Nordic Semiconductor ASA
# SPDX-License-Identifier: Apache-2.0

config BOARD_NRF52840_MODULE
	bool "NRF52840 Module"
	depends on SOC_NRF52840_QIAA
```

## boards/arm/nrf52840_module/Kconfig.defconfig
```kconfig
# nRF52840 module board configuration

# Copyright (c) 2016 Nordic Semiconductor ASA
# SPDX-License-Identifier: Apache-2.0

if BOARD_NRF52840_Module

config BOARD
	default "nrf52840_module"

if ADC

config ADC_0
	default y

endif # ADC

if I2C

config I2C_0
	default y

endif # I2C

if PWM

config PWM_0
	default y

endif # PWM

if SPI

config SPI_1
	default y

config SPI_2
	default y

config SPI_3
	default y

endif # SPI

if USB

config USB_NRFX
	default y

config USB_DEVICE_STACK
	default y

endif # USB

if IEEE802154

config IEEE802154_NRF5
	default y

endif # IEEE802154

config BT_CTLR
	default BT

endif # BOARD_NRF52840_MODULE
```
